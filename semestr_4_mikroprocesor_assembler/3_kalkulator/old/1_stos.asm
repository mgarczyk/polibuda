	LJMP START
	ORG	100H
START:

	LCALL LCD_INIT
	LCALL LCD_CLR
	
	LCALL WAIT_KEY
	MOV R3,A
	LCALL WRITE_HEX
	
	LCALL WAIT_KEY
	MOV R4,A
	MOV A,R3
	SWAP A
	ADD A,R4
	
	LCALL LCD_CLR
	LCALL WRITE_HEX  

	MOV A,R3
	MOV B,#10
	MUL AB
	ADD A,R4
	PUSH ACC
	
	LCALL WAIT_ENTER_NW
	LCALL LCD_CLR

;;;;;;;;;;;;;;;;;;;;;;;;;;;;;
	
	LCALL WAIT_KEY
	MOV R3,A
	LCALL WRITE_HEX
	
	LCALL WAIT_KEY
	MOV R4,A
	MOV A,R3
	SWAP A
	ADD A,R4
	
	LCALL LCD_CLR
	LCALL WRITE_HEX  

	MOV A,R3
	MOV B,#10
	MUL AB
	ADD A,R4
	PUSH ACC ; push dodaje do stosu
	
	LCALL WAIT_ENTER_NW
	LCALL LCD_CLR

;;;;;;;;;;;;;;;;;;;;;;;;;;;;;;;;;;
	LCALL WAIT_KEY

DODAWANIE:
	
	POP 41H ;2 liczba, POP usuwa liczbe ze stosu
	POP 42H ;1 liczba
	
	CJNE A,#10,ODEJM ; porownuje A z 10, jesli nie sa takie same to skacze do odejm
	; else WYKONAJ DODAWANIE
	LCALL LCD_CLR
	MOV A,41H
	LCALL WRITE_HEX
	MOV A,42H
	LCALL WRITE_HEX
	MOV A,'+'
	LCALL WRITE_DATA
	MOV A,'='
	LCALL WRITE_DATA
	MOV A,41H
	ADD A,42H
	LCALL WRITE_HEX
	

ODEJM:
	CJNE A,#11,MNOZ; SPRAWDŹ CZY ODEJMOWANIE
	; WYKONAJ ODEJMOWANIE	
	MOV A,41H
	LCALL WRITE_HEX
	MOV A,42H
	LCALL WRITE_HEX
	MOV A,'-'
	LCALL WRITE_DATA
	MOV A,'='
	LCALL WRITE_DATA
	MOV A,41H
	CLR C ;czyszczenie flagi przeniesienia (1 w "pamieci")
	SUBB A,42H
	LCALL WRITE_HEX
	
MNOZ:
	CJNE A,#12,DZIEL; SPRAWDŹ CZY MNOŻENIE
	; WYKONAJ MNOŻENIE
	LCALL WRITE_HEX
	MOV A,41H
	LCALL WRITE_HEX
	MOV A,42H
	LCALL WRITE_HEX
	MOV A,'*'
	LCALL WRITE_DATA
	MOV A,'='
	LCALL WRITE_DATA
	MOV A,41H
	MOV B,42H
	MUL AB
	LCALL WRITE_HEX

DZIEL:
	CJNE A,#13,STOP; SPRAWDŹ CZY MNOŻENIE
	; WYKONAJ DZIELENIE
	LCALL WRITE_HEX
	MOV A,41H
	LCALL WRITE_HEX
	MOV A,42H
	LCALL WRITE_HEX
	MOV A,'/'
	LCALL WRITE_DATA
	MOV A,'='
	LCALL WRITE_DATA
	MOV A,41H
	MOV B,42H
	DIV AB
	LCALL WRITE_HEX
	MOV B,A
	LCALL WRITE_HEX


STOP:			;nie wykonuj innych działań
	LJMP STOP	;- pozostań w pętli STOP
	NOP