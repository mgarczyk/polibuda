	LJMP START
	ORG	100H
START:
	LCALL LCD_CLR
	LCALL WAIT_KEY
	MOV R5,A
	LCALL WRITE_HEX

	LCALL WAIT_KEY
	MOV R6,A
	LCALL LCD_CLR
	MOV A,R5
	SWAP A
	ADD A,R6
	MOV R7,A
	LCALL WRITE_HEX

	MOV A, R5
	MOV B, #10
	MUL AB
	ADD A,R6
	PUSH ACC

	LCALL WAIT_ENTER_NW
	LCALL LCD_CLR

;;;;;;;;;;;;;;;;;;;;;;;;;;;;;

	LCALL LCD_INIT
	LCALL LCD_CLR

	LCALL WAIT_KEY
	MOV R5,A
	LCALL WRITE_HEX

	LCALL WAIT_KEY
	MOV R6,A
	LCALL LCD_CLR
	MOV A,R5
	SWAP A
	ADD A,R6
	MOV R3, A
	LCALL WRITE_HEX

	MOV A, R5
	MOV B, #10
	MUL AB
	ADD A,R6
	PUSH ACC

	LCALL WAIT_ENTER_NW
	LCALL LCD_CLR

;;;;;;;;;;;;;;;;;;;;;;;;;;;;;
	LCALL WAIT_KEY
	POP 32H
	POP 31H

	CJNE A,#10,ODEJM
	LCALL LCD_CLR
	MOV A, R7
	LCALL WRITE_HEX
	MOV A, #'+'
	LCALL WRITE_DATA
	MOV A, R3
	LCALL WRITE_HEX
	MOV A, #'='
	LCALL WRITE_DATA
	MOV A, 31H
	ADD A,32H
	MOV B,#10
	DIV AB
	SWAP A
	ADD A,B
	LCALL WRITE_HEX

ODEJM:
	CJNE A,#11,MNOZ
	LCALL LCD_CLR
	MOV A, R7
	LCALL WRITE_HEX
	MOV A, #'-'
	LCALL WRITE_DATA
	MOV A, R3
	LCALL WRITE_HEX
	MOV A, #'='
	LCALL WRITE_DATA
	MOV A, 31H
	CLR C
	SUBB A,32H
	MOV B,#10
	DIV AB
	SWAP A
	ADD A,B
	LCALL WRITE_HEX
MNOZ:
	CJNE A,#12,DZIEL
	LCALL LCD_CLR
	MOV A, R7
	LCALL WRITE_HEX
	MOV A, #'*'
	LCALL WRITE_DATA
	MOV A, R3
	LCALL WRITE_HEX
	MOV A, #'='
	LCALL WRITE_DATA
	MOV A, 31H
	MOV B, 32H
	MUL AB
	LCALL WRITE_HEX

DZIEL:
	CJNE A,#13,STOP
	LCALL LCD_CLR
	MOV A, R7
	LCALL WRITE_HEX
	MOV A, #':'
	LCALL WRITE_DATA
	MOV A, R3
	LCALL WRITE_HEX
	MOV A, #'='
	LCALL WRITE_DATA
	MOV A, 31H
	MOV B, 32H
	DIV AB
	MOV R4, B
	MOV B,#10
	DIV AB
	SWAP A
	ADD A,B
	MOV B,R4
	LCALL WRITE_HEX
	MOV A, #' '
	LCALL WRITE_DATA
	MOV A, B
	LCALL WRITE_HEX
	MOV B,#10
	DIV AB
	SWAP A
	ADD A,B
	MOV A, #'/'
	LCALL WRITE_DATA
	MOV A, R3
	LCALL WRITE_HEX
STOP:
	LJMP STOP
	NOP
